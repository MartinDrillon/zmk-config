## config/boards/shields/iteMX/Kconfig.defconfig
```kconfig
    if SHIELD_iteMX_left

config ZMK_KEYBOARD_NAME
    default "iteMX"

config ZMK_SPLIT_ROLE_CENTRAL
    default y

endif

if SHIELD_iteMX_left || SHIELD_iteMX_right

config ZMK_SPLIT
    default y

endif
```

## config/boards/shields/itemun/Kconfig.shield
```kconfig
config SHIELD_itemun_left
    def_bool $(shields_list_contains,itemun_left)
è
config SHIELD_itemun_right
    def_bool $(shields_list_contains,itemun_right)
```

## config/itemun/Kconfig.defconfig
```kconfig
if SHIELD_itemun_g

config ZMK_KEYBOARD_NAME
    default "itemun"

config ZMK_SPLIT_ROLE_CENTRAL
    default y

endif

if SHIELD_itemun_g || SHIELD_itemun_d

config ZMK_SPLIT
    default y

endif
```

## config/west.yml
```yaml
manifest:
  remotes:
    - name: zmkfirmware
      url-base: https://github.com/MartinDrillon)
  projects:
    - name: zmk
      remote: zmkfirmware
      revision: main
      import: app/west.yml
  self:
    path: config
```
